/* generated by SimpleXCP Generator */ ASAP2_VERSION 1 71
/begin PROJECT FanatecPedals "Fanatec Pedal Measurement"
/begin MODULE PedalModule "Pedal Data Module"
/* Measurement Variables */
/begin CHARACTERISTIC brake_raw "Brake Pedal Raw Value" VALUE 0 brake_raw UBYTE 0 255 ECU_ADDRESS 0x0000 /end CHARACTERISTIC
/begin CHARACTERISTIC throttle_raw "Throttle Pedal Raw Value" VALUE 0 throttle_raw UBYTE 0 255 ECU_ADDRESS 0x0000 /end CHARACTERISTIC
/begin CHARACTERISTIC vehicle_speed "Vehicle Speed" VALUE 0 vehicle_speed UWORD 0 300 ECU_ADDRESS 0x0000 /end CHARACTERISTIC
/begin CHARACTERISTIC drive_mode "Drive Mode" VALUE 0 drive_mode UBYTE 0 255 ECU_ADDRESS 0x0000 /end CHARACTERISTIC
/end MODULE
/end PROJECT
